## config/west.yml
```yaml
manifest:
  remotes:
    - name: zmkfirmware
      url-base: https://github.com/zmkfirmware
    - name: caksoylar
      url-base: https://github.com/caksoylar
    - name: urob
      url-base: https://github.com/urob
  projects:
    - name: zmk
      remote: caksoylar
      revision: caksoylar/zen-8bit
      import: app/west.yml
    - name: zmk-helpers
      revision: main
      path: modules/helpers
      remote: urob
  self:
    path: config
```
